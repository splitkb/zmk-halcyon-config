## boards/shields/kyria_rev3/Kconfig.shield
```kconfig
config SHIELD_KYRIA_REV3_DONGLE
    def_bool $(shields_list_contains,kyria_rev3_dongle)
```

## boards/shields/splitkb_aurora_corne/Kconfig.shield
```kconfig
config SHIELD_SPLITKB_AURORA_CORNE_DONGLE
    def_bool $(shields_list_contains,splitkb_aurora_corne_dongle)
```

## boards/shields/splitkb_aurora_helix/Kconfig.shield
```kconfig
config SHIELD_SPLITKB_AURORA_HELIX_DONGLE
    def_bool $(shields_list_contains,splitkb_aurora_helix_dongle)
```

## boards/shields/splitkb_aurora_lily58/Kconfig.shield
```kconfig
config SHIELD_SPLITKB_AURORA_LILY58_DONGLE
    def_bool $(shields_list_contains,splitkb_aurora_lily58_dongle)
```

## boards/shields/splitkb_aurora_sofle/Kconfig.shield
```kconfig
config SHIELD_SPLITKB_AURORA_SOFLE_DONGLE
    def_bool $(shields_list_contains,splitkb_aurora_sofle_dongle)
```

## boards/shields/splitkb_aurora_sweep/Kconfig.shield
```kconfig
config SHIELD_SPLITKB_AURORA_SWEEP_DONGLE
    def_bool $(shields_list_contains,splitkb_aurora_sweep_dongle)
```

## config/west.yml
```yaml
manifest:
  remotes:
    - name: zmkfirmware
      url-base: https://github.com/zmkfirmware
    - name: splitkb
      url-base: https://github.com/splitkb
    # Additional modules containing boards/shields/custom code can be listed here as well
    # See https://docs.zephyrproject.org/3.2.0/develop/west/manifest.html#projects
  projects:
    - name: zmk
      remote: zmkfirmware
      revision: main
      import: app/west.yml
    - name: zmk-halcyon-module
      remote: splitkb
      revision: main
    - name: zmk-driver-charge-led
      remote: splitkb
      revision: main
    - name: zmk-driver-vik-sleep
      remote: splitkb
      revision: main
  self:
    path: config
```
